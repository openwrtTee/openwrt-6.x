// SPDX-License-Identifier: GPL-2.0-or-later OR MIT

/dts-v1/;

#include "ipq5018-mx-base.dtsi"
#include "ipq5018-qcn6122.dtsi"

/ {
	model = "Linksys MX2000";
	compatible = "linksys,mx2000", "qcom,ipq5018";
};

&q6v5_wcss {
	/* The QCN6102 radio should map to UPD ID 2. Without       */
	/* bootargs, the firmware will expect it to be on UPD ID 3 */
	boot-args = <
			/*       type:	*/	0x1	/* PCIE0	*/
			/*     length:	*/	4
			/*     UPD ID:	*/	2
			/* reset GPIO:	*/	15
			/*   reserved:	*/	0 0>;
};

&wifi {
	status = "okay";

	qcom,rproc = <&q6_wcss_pd1>;
	qcom,ath11k-calibration-variant = "Linksys-MX2000";
	qcom,ath11k-fw-memory-mode = <1>;
	qcom,bdf-addr = <0x4c400000>;
};

&wifi1 {
	status = "okay";

	qcom,rproc = <&q6_wcss_pd2>;
	qcom,userpd-subsys-name = "q6v5_wcss_userpd2";
	qcom,ath11k-calibration-variant = "Linksys-MX2000";
	qcom,ath11k-fw-memory-mode = <1>;
	qcom,bdf-addr = <0x4d100000>;
	qcom,m3-dump-addr = <0x4df00000>;
};
